/* USER CODE BEGIN Header */
/**
  ******************************************************************************
  * @file           : main.c
  * @brief          : Main program body
  ******************************************************************************
  * @attention
  *
  * Copyright (c) 2022 STMicroelectronics.
  * All rights reserved.
  *
  * This software is licensed under terms that can be found in the LICENSE file
  * in the root directory of this software component.
  * If no LICENSE file comes with this software, it is provided AS-IS.
  *
  ******************************************************************************
  */
/* USER CODE END Header */
/* Includes ------------------------------------------------------------------*/
#include "main.h"
#include "adc.h"
#include "crc.h"
#include "dma.h"
#include "tim.h"
#include "usart.h"
#include "usb_device.h"
#include "gpio.h"

/* Private includes ----------------------------------------------------------*/
/* USER CODE BEGIN Includes */
#include "usbd_cdc_if.h"
/* USER CODE END Includes */

/* Private typedef -----------------------------------------------------------*/
/* USER CODE BEGIN PTD */

/* USER CODE END PTD */

/* Private define ------------------------------------------------------------*/
/* USER CODE BEGIN PD */
#define MIN 1187
#define MAX 2654
/* USER CODE END PD */

/* Private macro -------------------------------------------------------------*/
/* USER CODE BEGIN PM */

/* USER CODE END PM */

/* Private variables ---------------------------------------------------------*/

/* USER CODE BEGIN PV */
uint8_t bms_update;
uint16_t temp_in[4];
uint16_t temp_out[4];
uint8_t serial_out[154 + 8 + 4];
uint8_t BMS_REQUEST_DATA[10] = {"\x7E\xA1\x01\x00\x00\xBE\x18\x55\xAA\x55"}; // Requests 144 byte
uint8_t bms_rx_buffer[154];
uint16_t TEMP_TABLE[] = {
        1549, 1585, 1621, 1658, 1694, 1730, 1767, 1803, 1840, 1876, 1913, 1949, 1986, 2022, 2059, 2096,
        2132, 2169, 2206, 2242, 2279, 2316, 2353, 2390, 2426, 2463, 2500, 2537, 2574, 2611, 2648, 2685,
        2722, 2759, 2796, 2834, 2871, 2908, 2945, 2982, 3020, 3057, 3094, 3131, 3167, 3203, 3239, 3275,
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        64577, 64660, 64744, 64828, 64912, 64996, 65080, 65165, 65249, 65334, 65419, 65503
};

/* USER CODE END PV */

/* Private function prototypes -----------------------------------------------*/
void SystemClock_Config(void);
/* USER CODE BEGIN PFP */

/* USER CODE END PFP */

/* Private user code ---------------------------------------------------------*/
/* USER CODE BEGIN 0 */
void crc_init(void) {
    RCC->AHBENR |= RCC_AHBENR_CRCEN;  // enable clock for CRC
    CRC->CR |= CRC_CR_RESET;   // Reset calculation
}

void transmit_serial() {
    crc_init();
    uint8_t i;
    CRC->CR = 1;
    for (i = 0; i < (154 + 8); i++) {
        CRC->DR = serial_out[i];
    }
    uint32_t crc[1] = {CRC->DR};
    memcpy(serial_out + 8 + 154, crc, 4);
    if (!bms_update) memset(serial_out + 8, 0x00, 154);
    HAL_UART_Transmit(&huart3, serial_out, 154 + 8 + 4, 100);
    bms_update = 0;
}

void HAL_UART_RxCpltCallback(UART_HandleTypeDef *huart)
{
    if (huart == &huart1) {
        memcpy(serial_out + 8, bms_rx_buffer, 154);
        bms_update = 1;
    } else if (huart == &huart3) {
        HAL_NVIC_SystemReset();
    }
}

void HAL_ADC_ConvCpltCallback(ADC_HandleTypeDef* hadc) {
    //1864
    //1863 1860 1873
    if (temp_in[0] > MAX) temp_out[0] = 0xFFFF;
    else if (temp_in[0] < MIN) temp_out[0] = 0x0000;
    else temp_out[0] =  TEMP_TABLE[temp_in[0] - MIN];

    if (temp_in[1] > MAX) temp_out[1] = 0xFFFF;
    else if (temp_in[1] < MIN) temp_out[1] = 0x0000;
    else temp_out[1] =  TEMP_TABLE[temp_in[1] - MIN];

    if (temp_in[2] > MAX) temp_out[2] = 0xFFFF;
    else if (temp_in[2] < MIN) temp_out[2] = 0x0000;
    else temp_out[2] =  TEMP_TABLE[temp_in[2] - MIN];

    if (temp_in[3] > MAX) temp_out[3] = 0xFFFF;
    else if (temp_in[3] < MIN) temp_out[3] = 0x0000;
    else temp_out[3] =  TEMP_TABLE[temp_in[3] - MIN];
    /*float temp_out[4];
    temp_out[0] =  (float)TEMP_TABLE[temp_in[0] - MIN] / (65535.0f / 210.0f) - 60;
    temp_out[1] =  (float)TEMP_TABLE[temp_in[1] - MIN] / (65535.0f / 210.0f) - 60;
    temp_out[2] =  (float)TEMP_TABLE[temp_in[2] - MIN] / (65535.0f / 210.0f) - 60;
    temp_out[3] =  (float)TEMP_TABLE[temp_in[3] - MIN] / (65535.0f / 210.0f) - 60;*/


    uint8_t c[70];
    int l = sprintf(c, "%4d %4d %4d %4d %4d %4d %4d %4d %4d %4d %4d %4d %4d\n", ((uint16_t)serial_out[1] << 8) | serial_out[0],
                    ((uint16_t)serial_out[3] << 8) | serial_out[2],
                    ((uint16_t)serial_out[5] << 8) | serial_out[4],
                    ((uint16_t)serial_out[7] << 8) | serial_out[6],
                    (serial_out[9] << 8) , serial_out[8],
                    (serial_out[11] << 8) , serial_out[10],
                    (serial_out[13] << 8) , serial_out[12],
                    (serial_out[15]) , serial_out[14],
                    serial_out[16]);
    CDC_Transmit_FS(c, l);


    memcpy(serial_out, temp_out, 8);
    HAL_GPIO_TogglePin(GPIOC, GPIO_PIN_13);
    transmit_serial();
}

void HAL_TIM_PeriodElapsedCallback(TIM_HandleTypeDef* htim)
{
    HAL_ADC_Start_DMA(&hadc1, (uint32_t *) temp_in, 4);
    HAL_UART_Transmit(&huart1, BMS_REQUEST_DATA, 10, 100);
    HAL_UART_Receive_DMA(&huart1, bms_rx_buffer, 154);
}
/* USER CODE END 0 */

/**
  * @brief  The application entry point.
  * @retval int
  */
int main(void)
{
    /* USER CODE BEGIN 1 */

    /* USER CODE END 1 */

    /* MCU Configuration--------------------------------------------------------*/

    /* Reset of all peripherals, Initializes the Flash interface and the Systick. */
    HAL_Init();

    /* USER CODE BEGIN Init */

    /* USER CODE END Init */

    /* Configure the system clock */
    SystemClock_Config();

    /* USER CODE BEGIN SysInit */

    /* USER CODE END SysInit */

    /* Initialize all configured peripherals */
    MX_GPIO_Init();
    MX_DMA_Init();
    MX_USART1_UART_Init();
    MX_ADC1_Init();
    MX_USART3_UART_Init();
    MX_USB_DEVICE_Init();
    MX_TIM2_Init();
    MX_CRC_Init();
    /* USER CODE BEGIN 2 */
    bms_update = 0;
    HAL_ADCEx_Calibration_Start(&hadc1);
    HAL_GPIO_WritePin(GPIOC, GPIO_PIN_13, GPIO_PIN_RESET);
    HAL_TIM_Base_Start_IT(&htim2);
    HAL_UART_Receive_DMA(&huart3, NULL, 1);


    /* USER CODE END 2 */

    /* Infinite loop */
    /* USER CODE BEGIN WHILE */
    while (1)
    {
        /* USER CODE END WHILE */

        /* USER CODE BEGIN 3 */
    }
    /* USER CODE END 3 */
}

/**
  * @brief System Clock Configuration
  * @retval None
  */
void SystemClock_Config(void)
{
    RCC_OscInitTypeDef RCC_OscInitStruct = {0};
    RCC_ClkInitTypeDef RCC_ClkInitStruct = {0};
    RCC_PeriphCLKInitTypeDef PeriphClkInit = {0};

    /** Initializes the RCC Oscillators according to the specified parameters
    * in the RCC_OscInitTypeDef structure.
    */
    RCC_OscInitStruct.OscillatorType = RCC_OSCILLATORTYPE_HSE;
    RCC_OscInitStruct.HSEState = RCC_HSE_ON;
    RCC_OscInitStruct.HSEPredivValue = RCC_HSE_PREDIV_DIV1;
    RCC_OscInitStruct.HSIState = RCC_HSI_ON;
    RCC_OscInitStruct.PLL.PLLState = RCC_PLL_ON;
    RCC_OscInitStruct.PLL.PLLSource = RCC_PLLSOURCE_HSE;
    RCC_OscInitStruct.PLL.PLLMUL = RCC_PLL_MUL9;
    if (HAL_RCC_OscConfig(&RCC_OscInitStruct) != HAL_OK)
    {
        Error_Handler();
    }

    /** Initializes the CPU, AHB and APB buses clocks
    */
    RCC_ClkInitStruct.ClockType = RCC_CLOCKTYPE_HCLK|RCC_CLOCKTYPE_SYSCLK
                                  |RCC_CLOCKTYPE_PCLK1|RCC_CLOCKTYPE_PCLK2;
    RCC_ClkInitStruct.SYSCLKSource = RCC_SYSCLKSOURCE_PLLCLK;
    RCC_ClkInitStruct.AHBCLKDivider = RCC_SYSCLK_DIV1;
    RCC_ClkInitStruct.APB1CLKDivider = RCC_HCLK_DIV2;
    RCC_ClkInitStruct.APB2CLKDivider = RCC_HCLK_DIV1;

    if (HAL_RCC_ClockConfig(&RCC_ClkInitStruct, FLASH_LATENCY_2) != HAL_OK)
    {
        Error_Handler();
    }
    PeriphClkInit.PeriphClockSelection = RCC_PERIPHCLK_ADC|RCC_PERIPHCLK_USB;
    PeriphClkInit.AdcClockSelection = RCC_ADCPCLK2_DIV6;
    PeriphClkInit.UsbClockSelection = RCC_USBCLKSOURCE_PLL_DIV1_5;
    if (HAL_RCCEx_PeriphCLKConfig(&PeriphClkInit) != HAL_OK)
    {
        Error_Handler();
    }
}

/* USER CODE BEGIN 4 */

/* USER CODE END 4 */

/**
  * @brief  This function is executed in case of error occurrence.
  * @retval None
  */
void Error_Handler(void)
{
    /* USER CODE BEGIN Error_Handler_Debug */
    /* User can add his own implementation to report the HAL error return state */
    __disable_irq();
    while (1)
    {
    }
    /* USER CODE END Error_Handler_Debug */
}

#ifdef  USE_FULL_ASSERT
/**
  * @brief  Reports the name of the source file and the source line number
  *         where the assert_param error has occurred.
  * @param  file: pointer to the source file name
  * @param  line: assert_param error line source number
  * @retval None
  */
void assert_failed(uint8_t *file, uint32_t line)
{
  /* USER CODE BEGIN 6 */
  /* User can add his own implementation to report the file name and line number,
     ex: printf("Wrong parameters value: file %s on line %d\r\n", file, line) */
  /* USER CODE END 6 */
}
#endif /* USE_FULL_ASSERT */
